// SPDX-License-Identifier: GPL-2.0-or-later OR MIT
/*
 * Copyright (C) 2025 Toradex
 *
 * Device tree for Toradex Aquila AM69 SoM V1.0 on Aquila development carrier board
 */

/dts-v1/;

#include "k3-am69-aquila-dev.dts"
#include "k3-am69-aquila-v1.0.dtsi"

/ {
	model = "Toradex Aquila AM69 V1.0 on Aquila Development Board";
};
